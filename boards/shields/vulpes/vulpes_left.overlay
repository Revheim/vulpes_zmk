#include "vulpes.dtsi"

&kscan0 {
    compatible = "zmk,kscan-gpio";
    label = "KSCAN";
    diode-direction = "col2row";

    rows-gpios
        = <&gpio0 6  (GPIO_ACTIVE_HIGH | GPIO_PULL_DOWN)> // P0_06
        , <&gpio1 0  (GPIO_ACTIVE_HIGH | GPIO_PULL_DOWN)> // P1_00
        , <&gpio1 6  (GPIO_ACTIVE_HIGH | GPIO_PULL_DOWN)> // P1_06
        ;

    col-gpios
        = <&gpio0 22 GPIO_ACTIVE_HIGH> // P0_22
        , <&gpio0 8  GPIO_ACTIVE_HIGH> // P0_08
        , <&gpio0 17 GPIO_ACTIVE_HIGH> // P0_17
        , <&gpio0 20 GPIO_ACTIVE_HIGH> // P0_20
        , <&gpio0 24 GPIO_ACTIVE_HIGH> // P0_24
        , <&gpio0 11 GPIO_ACTIVE_HIGH> // P0_11
        ;
};
