#include "vulpes.dtsi"

&default_transform {
    col-offset = <6>;
};

&kscan0 {
    // compatible = "zmk,kscan-gpio";
    // label = "KSCAN";
    // diode-direction = "col2row";

    rows-gpios
        = <&gpio0 31 (GPIO_ACTIVE_HIGH | GPIO_PULL_DOWN)> // P0_31
        , <&gpio0 29 (GPIO_ACTIVE_HIGH | GPIO_PULL_DOWN)> // P0_29
        , <&gpio0 9  (GPIO_ACTIVE_HIGH | GPIO_PULL_DOWN)> // P0_09
        ;

    col-gpios
        = <&gpio1 7  GPIO_ACTIVE_HIGH> // P1_07
        , <&gpio1 15 GPIO_ACTIVE_HIGH> // P1_15
        , <&gpio1 13 GPIO_ACTIVE_HIGH> // P1_13
        , <&gpio0 2  GPIO_ACTIVE_HIGH> // P0_02
        , <&gpio1 11 GPIO_ACTIVE_HIGH> // P1_11
        , <&gpio0 10 GPIO_ACTIVE_HIGH> // P0_10
        ;
};

